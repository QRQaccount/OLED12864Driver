#include "OLED12864.h"

#define OLED_GPIO_Init()                                                                               \
    GPIO_InitTypeDef GPIO_InitStruct = {0};                                                            \
    __HAL_RCC_GPIOA_CLK_ENABLE();                                                                      \
    HAL_GPIO_WritePin(OLED_CLK_Port, OLED_CLK_GPIO_Pin, GPIO_PIN_RESET);                               \
    HAL_GPIO_WritePin(OLED_DC_Port, OLED_DC_GPIO_Pin, GPIO_PIN_RESET);                                 \
    HAL_GPIO_WritePin(OLED_DI_Port, OLED_DI_GPIO_Pin, GPIO_PIN_RESET);                                 \
    HAL_GPIO_WritePin(OLED_RST_Port, OLED_RST_GPIO_Pin, GPIO_PIN_RESET);                               \
    GPIO_InitStruct.Pin = OLED_CLK_GPIO_Pin | OLED_DC_GPIO_Pin | OLED_DI_GPIO_Pin | OLED_RST_GPIO_Pin; \
    GPIO_InitStruct.Mode = GPIO_MODE_OUTPUT_PP;                                                        \
    GPIO_InitStruct.Pull = GPIO_NOPULL;                                                                \
    GPIO_InitStruct.Speed = GPIO_SPEED_FREQ_MEDIUM;                                                    \
    HAL_GPIO_Init(GPIOA, &GPIO_InitStruct);

#define OLED_DC_High() HAL_GPIO_WritePin(OLED_DC_Port, OLED_DC_GPIO_Pin, GPIO_PIN_SET)
#define OLED_DC_Low() HAL_GPIO_WritePin(OLED_DC_Port, OLED_DC_GPIO_Pin, GPIO_PIN_RESET)
#define OLED_DI_High() HAL_GPIO_WritePin(OLED_DI_Port, OLED_DI_GPIO_Pin, GPIO_PIN_SET)
#define OLED_DI_Low() HAL_GPIO_WritePin(OLED_DI_Port, OLED_DI_GPIO_Pin, GPIO_PIN_RESET)
#define OLED_RST_High() HAL_GPIO_WritePin(OLED_RST_Port, OLED_RST_GPIO_Pin, GPIO_PIN_SET)
#define OLED_RST_Low() HAL_GPIO_WritePin(OLED_RST_Port, OLED_RST_GPIO_Pin, GPIO_PIN_RESET)
#define OLED_CLK_High() HAL_GPIO_WritePin(OLED_CLK_Port, OLED_CLK_GPIO_Pin, GPIO_PIN_SET)
#define OLED_CLK_Low() HAL_GPIO_WritePin(OLED_CLK_Port, OLED_CLK_GPIO_Pin, GPIO_PIN_RESET)

// ms级延时
#define OLED_CLK_Delay_ms(x) HAL_Delay(x)

// 该语句宏仅用于CLK信号的延时
// 需要更加精细的控制请自行更换延时函数
#define OLED_CLK_Delay asm("nop")

#define X_WIDTH 128 // x轴宽度
#define Y_HEIGHT 64 // y轴高度

// 大小为6*8的字符
const unsigned char ascii_6x8[][6] =
    {
        {0x00, 0x00, 0x00, 0x00, 0x00, 0x00}, // sp
        {0x00, 0x00, 0x00, 0x2f, 0x00, 0x00}, // !
        {0x00, 0x00, 0x07, 0x00, 0x07, 0x00}, // "
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        {0x14, 0x14, 0x14, 0x14, 0x14, 0x14}  // horiz lines
};

// 大小为8*16的字符
const unsigned char ascii_8X16[][16] =
    {
        {0x00, 0x00, 0x00, 0x00, 0x00, 0x00, 0x00, 0x00, 0x00, 0x00, 0x00, 0x00, 0x00, 0x00, 0x00, 0x00}, // 0
        {0x00, 0x00, 0x00, 0xF8, 0x00, 0x00, 0x00, 0x00, 0x00, 0x00, 0x00, 0x33, 0x30, 0x00, 0x00, 0x00}, //!1
        {0x00, 0x10, 0x0C, 0x06, 0x10, 0x0C, 0x06, 0x00, 0x00, 0x00, 0x00, 0x00, 0x00, 0x00, 0x00, 0x00}, //"2
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        {0x00, 0x06, 0x01, 0x01, 0x02, 0x02, 0x04, 0x04, 0x00, 0x00, 0x00, 0x00, 0x00, 0x00, 0x00, 0x00}, //~94

};

#if USE_IMAGE_MANAGE == 1
unsigned char OLED_Image[8][128] = {0};

/**
 * 
 * 设置图形中(x,y)点的值
 * @param value 需要设置的值 0 1
 * @param x x轴坐标
 * @param y y轴坐标
 * @return 被修改后页的值
*/
uint8_t OLED_Set_Value(uint8_t value, uint8_t x, uint8_t y)
{
    uint8_t page_value = OLED_Image[y >> 3][x];
    uint8_t __y = y % 8;
    if (value > 1)
    {
        page_value = page_value | (0x01 << (8 - __y));
    }
    else
    {
        page_value = page_value & (0x7f >> (__y - 1));
    }
    OLED_Image[y >> 3][x] = page_value;
    return page_value;
}

/**
 * 
 * 取出图像数组中(x,y)的值
 * @param x x轴坐标
 * @param y y轴坐标
 * @return 返回uint8_t的值
*/
uint8_t OLED_Get_Value(uint8_t x, uint8_t y)
{
    uint8_t page_value = OLED_Image[y >> 3][x];
    uint8_t __y = y % 8;
    if (page_value & (0x01 << (8 - __y)))
    {
        return 1;
    }
    else
    {
        return 0;
    }
}

void OLED_Set_Page(uint8_t value, uint8_t x, uint8_t page)
{
    OLED_Image[page][x] = value;
}

uint8_t OLED_Get_Page(uint8_t x, uint8_t page)
{
    return OLED_Image[page][x];
}
#endif

/**
 * 
 * 写入数据
 * @param data 数据
*/
void OLED_Write_Data(unsigned char data)
{
    // 字长
    uint8_t word = 8;
    OLED_DC_High();
    OLED_CLK_Delay;
    OLED_CLK_Low();
    OLED_CLK_Delay;
    while (word--)
    {
        if (data & 0x80)
        {
            OLED_DI_High();
        }
        else
        {
            OLED_DI_Low();
        }
        OLED_CLK_High();
        for (uint8_t i = 0; i < 1; i++)
        {
            OLED_CLK_Delay;
        }
        OLED_CLK_Low();
        OLED_CLK_Delay;
        data <<= 1;
    }
}

/**
 * 
 * 写入命令
 * @param cmd 命令
*/
void OLED_Write_Cmd(unsigned char cmd)
{
    uint8_t word = 8;
    OLED_DC_Low();
    OLED_CLK_Delay;
    OLED_CLK_Low();
    OLED_CLK_Delay;
    while (word--)
    {
        if (cmd & 0x80)
        {
            OLED_DI_High();
        }
        else
        {
            OLED_DI_Low();
            OLED_CLK_Delay;
        }
        OLED_CLK_High();
        for (uint8_t i = 0; i < 1; i++)
        {
            OLED_CLK_Delay;
        }
        OLED_CLK_Low();
        OLED_CLK_Delay;
        cmd <<= 1;
        OLED_CLK_Delay;
    }
}

/** 
 * 设置此时指向的块
 * @param x 此时的x轴位置 (0,128)
 * @param page  一页大小为8像素 范围(0,7)
*/
void OLED_Set_Pointer(uint8_t x, uint8_t page)
{
    OLED_Write_Cmd(0xb0 + page);
    OLED_Write_Cmd((x & 0xf0) >> 4 | 0x10);
    OLED_Write_Cmd((x & 0x0f) | 0x01);
}

void OLED_Fill(unsigned char data)
{
    uint8_t x, y;
    for (y = 0; y < 8; y++)
    {
        OLED_Write_Cmd(0xb0 + y);
        OLED_Write_Cmd(0x01);
        OLED_Write_Cmd(0x10);
        for (x = 0; x < X_WIDTH; x++)
        {

            OLED_Write_Data(data);
        }
    }
}

void OLED_Init(void)
{
    OLED_GPIO_Init();
    OLED_CLK_High();
    OLED_RST_Low();
    OLED_CLK_Delay_ms(50);
    OLED_RST_High();

    OLED_Write_Cmd(0xae); // 关闭控制
    OLED_Write_Cmd(0x00); // 设置低列位置
    OLED_Write_Cmd(0x10); // 设置高列位置
    OLED_Write_Cmd(0x40); // 设置初始行位置
    OLED_Write_Cmd(0x81); // 设置对比度控制寄存器
    OLED_Write_Cmd(0xcf); // Set SEG Output Current Brightness
    OLED_Write_Cmd(0xa1); //--Set SEG/Column Mapping     0xa0左右反置 0xa1正常
    OLED_Write_Cmd(0xc8); //Set COM/Row Scan Direction   0xc0上下反置 0xc8正常
    OLED_Write_Cmd(0xa6); //--set normal display
    OLED_Write_Cmd(0xa8); //--set multiplex ratio(1 to 64)
    OLED_Write_Cmd(0x3f); //--1/64 duty
    OLED_Write_Cmd(0xd3); //-set display offset	Shift Mapping RAM Counter (0x00~0x3F)
    OLED_Write_Cmd(0x00); //-not offset
    OLED_Write_Cmd(0xd5); //--set display clock divide ratio/oscillator frequency
    OLED_Write_Cmd(0x80); //--set divide ratio, Set Clock as 100 Frames/Sec
    OLED_Write_Cmd(0xd9); //--set pre-charge period
    OLED_Write_Cmd(0xf1); //Set Pre-Charge as 15 Clocks & Discharge as 1 Clock
    OLED_Write_Cmd(0xda); //--set com pins hardware configuration
    OLED_Write_Cmd(0x12);
    OLED_Write_Cmd(0xdb); //--set vcomh
    OLED_Write_Cmd(0x40); //Set VCOM Deselect Level
    OLED_Write_Cmd(0x20); //-Set Page Addressing Mode (0x00/0x01/0x02)
    OLED_Write_Cmd(0x02); //
    OLED_Write_Cmd(0x8d); //--set Charge Pump enable/disable
    OLED_Write_Cmd(0x14); //--set(0x10) disable
    OLED_Write_Cmd(0xa4); // Disable Entire Display On (0xa4/0xa5)
    OLED_Write_Cmd(0xa6); // Disable Inverse Display On (0xa6/a7)
    OLED_Write_Cmd(0xaf); //--turn on oled panel
    OLED_Fill(0x00);      //初始清屏

    OLED_Set_Pointer(0, 0);
}

void OLED_DrawCharacter(unsigned char character, OLED_Point start_point, FontSize font_size)
{
    unsigned char charater_index;
    uint32_t col_index;
    charater_index = character - 32;
    switch (font_size)
    {
    case small:

        if (start_point.x > 126)
        {
            start_point.x = 0;
            start_point.y++;
        }
        OLED_Set_Pointer(start_point.x, start_point.y >> 3);
        for (col_index = 0; col_index < 6; col_index++)
        {
#if USE_IMAGE_MANAGE == 1
            uint8_t page_value = OLED_Get_Page(start_point.x, start_point.y >> 3) | ascii_6x8[charater_index][col_index];
            OLED_Set_Page(page_value, start_point.x, start_point.y >> 3);
            OLED_Write_Data(page_value);
#else
            OLED_Write_Data(ascii_6x8[charater_index][col_index]);
#endif
        }
        break;
    case big:
        // 将字符与字体库中的字对应

        if (start_point.x > 120)
        {
            start_point.x = 0;
            start_point.y += 8;
        }
        OLED_Set_Pointer(start_point.x, start_point.y >> 3);
#if USE_IMAGE_MANAGE == 1
        for (col_index = 0; col_index < 8; col_index++)
        {
            uint8_t page_value = OLED_Get_Page(start_point.x, start_point.y >> 3) | ascii_8X16[charater_index][col_index];
            OLED_Set_Page(page_value, start_point.x, start_point.y >> 3);
            OLED_Write_Data(page_value);
        }
        OLED_Set_Pointer(start_point.x, start_point.y + 8 >> 3);
        for (col_index = 8; col_index < 15; col_index++)
        {
            uint8_t page_value = OLED_Get_Page(start_point.x, start_point.y >> 3) | ascii_8X16[charater_index][col_index];
            OLED_Set_Page(page_value, start_point.x, start_point.y >> 3);
            OLED_Write_Data(page_value);
        }
#else
        for (col_index = 0; col_index < 8; col_index++)
        {
            OLED_Write_Data(ascii_8X16[charater_index][col_index]);
        }
        OLED_Set_Pointer(start_point.x, start_point.y + 8 >> 3);
        for (col_index = 8; col_index < 15; col_index++)
        {
            OLED_Write_Data(ascii_8X16[charater_index][col_index]);
        }
#endif

        break;
    default:
        break;
    }
}

void OLED_DrawString(const unsigned char str[], OLED_Point start_point, FontSize font_size)
{
    uint32_t index = 0, col_index;
    unsigned char charater_index;
    switch (font_size)
    {
    case small:
        while (str[index] != '\0')
        {
            // 将字符与字体库中的字对应
            charater_index = str[index] - 32;
            if (start_point.x > 126)
            {
                start_point.x = 0;
                start_point.y += 8;
            }
            OLED_Set_Pointer(start_point.x, start_point.y >> 3);
            for (col_index = 0; col_index < 6; col_index++)
            {
#if USE_IMAGE_MANAGE == 1
                uint8_t page_value = OLED_Get_Page(start_point.x, start_point.y >> 3) | ascii_6x8[charater_index][col_index];
                OLED_Set_Page(page_value, start_point.x, start_point.y >> 3);
                OLED_Write_Data(page_value);
#else
                OLED_Write_Data(ascii_6x8[charater_index][col_index]);
#endif
            }
            start_point.x += 6;
            index++;
        }

        break;
    case big:
        while (str[index] != '\0')
        {
            // 将字符与字体库中的字对应
            charater_index = str[index] - 32;
            if (start_point.x > 120)
            {
                start_point.x = 0;
                start_point.y += 8;
            }
            OLED_Set_Pointer(start_point.x, start_point.y >> 3);
#if USE_IMAGE_MANAGE == 1
            for (col_index = 0; col_index < 8; col_index++)
            {
                uint8_t page_value = OLED_Get_Page(start_point.x, start_point.y >> 3) | ascii_8X16[charater_index][col_index];
                OLED_Set_Page(page_value, start_point.x, start_point.y >> 3);
                OLED_Write_Data(page_value);
            }
            OLED_Set_Pointer(start_point.x, start_point.y + 8 >> 3);
            for (col_index = 8; col_index < 15; col_index++)
            {
                uint8_t page_value = OLED_Get_Page(start_point.x, start_point.y >> 3) | ascii_8X16[charater_index][col_index];
                OLED_Set_Page(page_value, start_point.x, start_point.y >> 3);
                OLED_Write_Data(page_value);
            }
#else
            for (col_index = 0; col_index < 8; col_index++)
            {
                OLED_Write_Data(ascii_8X16[charater_index][col_index]);
            }
            OLED_Set_Pointer(start_point.x, start_point.y + 8 >> 3);
            for (col_index = 8; col_index < 15; col_index++)
            {
                OLED_Write_Data(ascii_8X16[charater_index][col_index]);
            }
#endif
            start_point.x += 8;
            index++;
        }

        break;
    default:
        break;
    }
}

#if USE_IMAGE_MANAGE == 1
void OLED_DrawPoint(OLED_Point point)
{
    uint8_t value;
    OLED_Set_Pointer(point.x, point.y >> 3);
    value = OLED_Set_Value(1, point.x, point.y);
    OLED_Write_Data(value);
}

void OLED_DrawLine(OLED_Point point1, OLED_Point point2)
{
    OLED_Point point;
    point.x = point1.x;
    point.y = point.y;
    uint16_t __x = point1.x >= point2.x ? (point1.x - point2.x) : (point2.x - point1.x);
    uint16_t __y = point1.y >= point2.y ? (point1.y - point2.y) : (point2.y - point1.y);
    uint8_t value = 0x01, temp = 0x00;
    if (__x == 0)
    {
    }
    else if (__y == 0)
    {
    }
    else
    {
    }
}

#endif
